VERSION ""

NS_ :

BS_:

BU_: Vector__XXX

BO_ 4288 GPS_Latitude: 4 Vector__XXX
 SG_ Latitude : 0|32@1- (0.000001,0) [-90|90] "°" Vector__XXX

BO_ 4289 GPS_Longitude: 4 Vector__XXX
 SG_ Longitude : 0|32@1- (0.000001,0) [-180|180] "°" Vector__XXX

CM_ "Photon GPS compatibility: staging/HighNoon car GPS IDs used by Live View and the AWS TCP feed.";
CM_ BO_ 4288 "Signed microdegree latitude from the car DAQ path";
CM_ BO_ 4289 "Signed microdegree longitude from the car DAQ path";
