VERSION ""

NS_ :

BS_:

BU_:

BO_ 0 AC_Identifier: 1 Vector__XXX
	SG_ Identifier : 0|8@1+ (1,0) [0|0] "" Vector__XXX

BO_ 1 AC_Size: 4 Vector__XXX
	SG_ Size : 0|32@1+ (1,0) [0|0] "bytes" Vector__XXX

BO_ 2 AC_Speed_Kmh: 4 Vector__XXX
	SG_ Speed_Kmh : 0|32@1+ (1,0) [0|0] "km/h" Vector__XXX

BO_ 3 AC_Speed_Mph: 4 Vector__XXX
	SG_ Speed_Mph : 0|32@1+ (1,0) [0|0] "mph" Vector__XXX

BO_ 4 AC_Speed_Ms: 4 Vector__XXX
	SG_ Speed_Ms : 0|32@1+ (1,0) [0|0] "m/s" Vector__XXX

BO_ 5 AC_Abs_Enabled: 1 Vector__XXX
	SG_ Abs_Enabled : 0|8@1+ (1,0) [0|0] "" Vector__XXX

BO_ 6 AC_Abs_InAction: 1 Vector__XXX
	SG_ Abs_InAction : 0|8@1+ (1,0) [0|0] "" Vector__XXX

BO_ 7 AC_Tc_InAction: 1 Vector__XXX
	SG_ Tc_InAction : 0|8@1+ (1,0) [0|0] "" Vector__XXX

BO_ 8 AC_Tc_Enabled: 1 Vector__XXX
	SG_ Tc_Enabled : 0|8@1+ (1,0) [0|0] "" Vector__XXX

BO_ 9 AC_In_Pit: 1 Vector__XXX
	SG_ In_Pit : 0|8@1+ (1,0) [0|0] "" Vector__XXX

BO_ 10 AC_Engine_Limiter_On: 1 Vector__XXX
	SG_ Engine_Limiter_On : 0|8@1+ (1,0) [0|0] "" Vector__XXX

BO_ 11 AC_AccG_Vertical: 4 Vector__XXX
	SG_ AccG_Vertical : 0|32@1- (1,0) [0|0] "g" Vector__XXX

BO_ 12 AC_AccG_Horizontal: 4 Vector__XXX
	SG_ AccG_Horizontal : 0|32@1- (1,0) [0|0] "g" Vector__XXX

BO_ 13 AC_AccG_Frontal: 4 Vector__XXX
	SG_ AccG_Frontal : 0|32@1- (1,0) [0|0] "g" Vector__XXX

BO_ 14 AC_LapTime: 4 Vector__XXX
	SG_ LapTime : 0|32@1+ (1,0) [0|0] "ms" Vector__XXX

BO_ 15 AC_LastLap: 4 Vector__XXX
	SG_ LastLap : 0|32@1+ (1,0) [0|0] "ms" Vector__XXX

BO_ 16 AC_BestLap: 4 Vector__XXX
	SG_ BestLap : 0|32@1+ (1,0) [0|0] "ms" Vector__XXX

BO_ 17 AC_LapCount: 4 Vector__XXX
	SG_ LapCount : 0|32@1+ (1,0) [0|0] "" Vector__XXX

BO_ 18 AC_Gas: 4 Vector__XXX
	SG_ Gas : 0|32@1+ (1,0) [0|0] "%" Vector__XXX

BO_ 19 AC_Brake: 4 Vector__XXX
	SG_ Brake : 0|32@1+ (1,0) [0|0] "%" Vector__XXX

BO_ 20 AC_Clutch: 4 Vector__XXX
	SG_ Clutch : 0|32@1+ (1,0) [0|0] "%" Vector__XXX

BO_ 21 AC_EngineRPM: 4 Vector__XXX
	SG_ EngineRPM : 0|32@1+ (1,0) [0|0] "rpm" Vector__XXX

BO_ 22 AC_Steer: 4 Vector__XXX
	SG_ Steer : 0|32@1- (1,0) [0|0] "rad" Vector__XXX

BO_ 23 AC_Gear: 4 Vector__XXX
	SG_ Gear : 0|32@1- (1,0) [0|0] "" Vector__XXX

BO_ 24 AC_CgHeight: 4 Vector__XXX
	SG_ CgHeight : 0|32@1+ (1,0) [0|0] "m" Vector__XXX

BO_ 25 AC_WheelAngularSpeed_l: 8 Vector__XXX
	SG_ WheelAngularSpeed_0 : 0|32@1+ (1,0) [0|0] "rad/s" Vector__XXX
	SG_ WheelAngularSpeed_1 : 32|32@1+ (1,0) [0|0] "rad/s" Vector__XXX

BO_ 26 AC_WheelAngularSpeed_h: 8 Vector__XXX
	SG_ WheelAngularSpeed_2 : 0|32@1+ (1,0) [0|0] "rad/s" Vector__XXX
	SG_ WheelAngularSpeed_3 : 32|32@1+ (1,0) [0|0] "rad/s" Vector__XXX

BO_ 27 AC_SlipAngle_l: 8 Vector__XXX
	SG_ SlipAngle_0 : 0|32@1- (1,0) [0|0] "rad" Vector__XXX
	SG_ SlipAngle_1 : 32|32@1- (1,0) [0|0] "rad" Vector__XXX

BO_ 28 AC_SlipAngle_h: 8 Vector__XXX
	SG_ SlipAngle_2 : 0|32@1- (1,0) [0|0] "rad" Vector__XXX
	SG_ SlipAngle_3 : 32|32@1- (1,0) [0|0] "rad" Vector__XXX

BO_ 29 AC_SlipAngle_ContactPatch_l: 8 Vector__XXX
	SG_ SlipAngle_ContactPatch_0 : 0|32@1- (1,0) [0|0] "rad" Vector__XXX
	SG_ SlipAngle_ContactPatch_1 : 32|32@1- (1,0) [0|0] "rad" Vector__XXX

BO_ 30 AC_SlipAngle_ContactPatch_h: 8 Vector__XXX
	SG_ SlipAngle_ContactPatch_2 : 0|32@1- (1,0) [0|0] "rad" Vector__XXX
	SG_ SlipAngle_ContactPatch_3 : 32|32@1- (1,0) [0|0] "rad" Vector__XXX

BO_ 31 AC_SlipRatio_l: 8 Vector__XXX
	SG_ SlipRatio_0 : 0|32@1- (1,0) [0|0] "" Vector__XXX
	SG_ SlipRatio_1 : 32|32@1- (1,0) [0|0] "" Vector__XXX

BO_ 32 AC_SlipRatio_h: 8 Vector__XXX
	SG_ SlipRatio_2 : 0|32@1- (1,0) [0|0] "" Vector__XXX
	SG_ SlipRatio_3 : 32|32@1- (1,0) [0|0] "" Vector__XXX

BO_ 33 AC_TyreSlip_l: 8 Vector__XXX
	SG_ TyreSlip_0 : 0|32@1- (1,0) [0|0] "" Vector__XXX
	SG_ TyreSlip_1 : 32|32@1- (1,0) [0|0] "" Vector__XXX

BO_ 34 AC_TyreSlip_h: 8 Vector__XXX
	SG_ TyreSlip_2 : 0|32@1- (1,0) [0|0] "" Vector__XXX
	SG_ TyreSlip_3 : 32|32@1- (1,0) [0|0] "" Vector__XXX

BO_ 35 AC_NdSlip_l: 8 Vector__XXX
	SG_ NdSlip_0 : 0|32@1- (1,0) [0|0] "" Vector__XXX
	SG_ NdSlip_1 : 32|32@1- (1,0) [0|0] "" Vector__XXX

BO_ 36 AC_NdSlip_h: 8 Vector__XXX
	SG_ NdSlip_2 : 0|32@1- (1,0) [0|0] "" Vector__XXX
	SG_ NdSlip_3 : 32|32@1- (1,0) [0|0] "" Vector__XXX

BO_ 37 AC_Load_l: 8 Vector__XXX
	SG_ Load_0 : 0|32@1+ (1,0) [0|0] "N" Vector__XXX
	SG_ Load_1 : 32|32@1+ (1,0) [0|0] "N" Vector__XXX

BO_ 38 AC_Load_h: 8 Vector__XXX
	SG_ Load_2 : 0|32@1+ (1,0) [0|0] "N" Vector__XXX
	SG_ Load_3 : 32|32@1+ (1,0) [0|0] "N" Vector__XXX

BO_ 39 AC_Dy_l: 8 Vector__XXX
	SG_ Dy_0 : 0|32@1- (1,0) [0|0] "" Vector__XXX
	SG_ Dy_1 : 32|32@1- (1,0) [0|0] "" Vector__XXX

BO_ 40 AC_Dy_h: 8 Vector__XXX
	SG_ Dy_2 : 0|32@1- (1,0) [0|0] "" Vector__XXX
	SG_ Dy_3 : 32|32@1- (1,0) [0|0] "" Vector__XXX

BO_ 41 AC_Mz_l: 8 Vector__XXX
	SG_ Mz_0 : 0|32@1- (1,0) [0|0] "" Vector__XXX
	SG_ Mz_1 : 32|32@1- (1,0) [0|0] "" Vector__XXX

BO_ 42 AC_Mz_h: 8 Vector__XXX
	SG_ Mz_2 : 0|32@1- (1,0) [0|0] "" Vector__XXX
	SG_ Mz_3 : 32|32@1- (1,0) [0|0] "" Vector__XXX

BO_ 43 AC_TyreDirtyLevel_l: 8 Vector__XXX
	SG_ TyreDirtyLevel_0 : 0|32@1+ (1,0) [0|0] "" Vector__XXX
	SG_ TyreDirtyLevel_1 : 32|32@1+ (1,0) [0|0] "" Vector__XXX

BO_ 44 AC_TyreDirtyLevel_h: 8 Vector__XXX
	SG_ TyreDirtyLevel_2 : 0|32@1+ (1,0) [0|0] "" Vector__XXX
	SG_ TyreDirtyLevel_3 : 32|32@1+ (1,0) [0|0] "" Vector__XXX

BO_ 45 AC_CamberRAD_l: 8 Vector__XXX
	SG_ CamberRAD_0 : 0|32@1- (1,0) [0|0] "rad" Vector__XXX
	SG_ CamberRAD_1 : 32|32@1- (1,0) [0|0] "rad" Vector__XXX

BO_ 46 AC_CamberRAD_h: 8 Vector__XXX
	SG_ CamberRAD_2 : 0|32@1- (1,0) [0|0] "rad" Vector__XXX
	SG_ CamberRAD_3 : 32|32@1- (1,0) [0|0] "rad" Vector__XXX

BO_ 47 AC_TyreRadius_l: 8 Vector__XXX
	SG_ TyreRadius_0 : 0|32@1+ (1,0) [0|0] "m" Vector__XXX
	SG_ TyreRadius_1 : 32|32@1+ (1,0) [0|0] "m" Vector__XXX

BO_ 48 AC_TyreRadius_h: 8 Vector__XXX
	SG_ TyreRadius_2 : 0|32@1+ (1,0) [0|0] "m" Vector__XXX
	SG_ TyreRadius_3 : 32|32@1+ (1,0) [0|0] "m" Vector__XXX

BO_ 49 AC_TyreLoadedRadius_l: 8 Vector__XXX
	SG_ TyreLoadedRadius_0 : 0|32@1+ (1,0) [0|0] "m" Vector__XXX
	SG_ TyreLoadedRadius_1 : 32|32@1+ (1,0) [0|0] "m" Vector__XXX

BO_ 50 AC_TyreLoadedRadius_h: 8 Vector__XXX
	SG_ TyreLoadedRadius_2 : 0|32@1+ (1,0) [0|0] "m" Vector__XXX
	SG_ TyreLoadedRadius_3 : 32|32@1+ (1,0) [0|0] "m" Vector__XXX

BO_ 51 AC_SuspensionHeight_l: 8 Vector__XXX
	SG_ SuspensionHeight_0 : 0|32@1+ (1,0) [0|0] "m" Vector__XXX
	SG_ SuspensionHeight_1 : 32|32@1+ (1,0) [0|0] "m" Vector__XXX

BO_ 52 AC_SuspensionHeight_h: 8 Vector__XXX
	SG_ SuspensionHeight_2 : 0|32@1+ (1,0) [0|0] "m" Vector__XXX
	SG_ SuspensionHeight_3 : 32|32@1+ (1,0) [0|0] "m" Vector__XXX

BO_ 53 AC_CarPositionNormalized: 4 Vector__XXX
	SG_ CarPositionNormalized : 0|32@1+ (1,0) [0|0] "" Vector__XXX

BO_ 54 AC_CarSlope: 4 Vector__XXX
	SG_ CarSlope : 0|32@1- (1,0) [0|0] "rad" Vector__XXX

BO_ 55 AC_CarCoordinates_X: 4 Vector__XXX
	SG_ CarCoordinates_X : 0|32@1- (1,0) [0|0] "m" Vector__XXX

BO_ 56 AC_CarCoordinates_Y: 4 Vector__XXX
	SG_ CarCoordinates_Y : 0|32@1- (1,0) [0|0] "m" Vector__XXX

BO_ 57 AC_CarCoordinates_Z: 4 Vector__XXX
	SG_ CarCoordinates_Z : 0|32@1- (1,0) [0|0] "m" Vector__XXX

CM_ BO_ 0 "Message identifier";
CM_ SG_ 0 Identifier "Message identifier";
CM_ BO_ 1 "Message payload size";
CM_ SG_ 1 Size "Message payload size";
CM_ BO_ 2 "Vehicle speed";corsa.
CM_ SG_ 2 Speed_Kmh "Vehicle speed";
CM_ BO_ 3 "Vehicle speed";
CM_ SG_ 3 Speed_Mph "Vehicle speed";
CM_ BO_ 4 "Vehicle speed";
CM_ SG_ 4 Speed_Ms "Vehicle speed";
CM_ BO_ 5 "ABS enabled";
CM_ SG_ 5 Abs_Enabled "ABS enabled";
CM_ BO_ 6 "ABS active";
CM_ SG_ 6 Abs_InAction "ABS active";
CM_ BO_ 7 "TC active";
CM_ SG_ 7 Tc_InAction "TC active";
CM_ BO_ 8 "TC enabled";
CM_ SG_ 8 Tc_Enabled "TC enabled";
CM_ BO_ 9 "In pit lane";
CM_ SG_ 9 In_Pit "In pit lane";
CM_ BO_ 10 "Engine limiter active";
CM_ SG_ 10 Engine_Limiter_On "Engine limiter active";
CM_ BO_ 11 "Vertical acceleration";
CM_ SG_ 11 AccG_Vertical "Vertical acceleration";
CM_ BO_ 12 "Lateral acceleration";
CM_ SG_ 12 AccG_Horizontal "Lateral acceleration";
CM_ BO_ 13 "Longitudinal acceleration";
CM_ SG_ 13 AccG_Frontal "Longitudinal acceleration";
CM_ BO_ 14 "Current lap time";
CM_ SG_ 14 LapTime "Current lap time";
CM_ BO_ 15 "Last lap time";
CM_ SG_ 15 LastLap "Last lap time";
CM_ BO_ 16 "Best lap time";
CM_ SG_ 16 BestLap "Best lap time";
CM_ BO_ 17 "Completed laps";
CM_ SG_ 17 LapCount "Completed laps";
CM_ BO_ 18 "Throttle position";
CM_ SG_ 18 Gas "Throttle position";
CM_ BO_ 19 "Brake position";
CM_ SG_ 19 Brake "Brake position";
CM_ BO_ 20 "Clutch position";
CM_ SG_ 20 Clutch "Clutch position";
CM_ BO_ 21 "Engine speed";
CM_ SG_ 21 EngineRPM "Engine speed";
CM_ BO_ 22 "Steering angle";
CM_ SG_ 22 Steer "Steering angle";
CM_ BO_ 23 "Current gear";
CM_ SG_ 23 Gear "Current gear";
CM_ BO_ 24 "Center of gravity height";
CM_ SG_ 24 CgHeight "Center of gravity height";
CM_ BO_ 25 "Wheel angular speed (low)";
CM_ SG_ 25 WheelAngularSpeed_0 "Wheel angular speed";
CM_ SG_ 25 WheelAngularSpeed_1 "Wheel angular speed";
CM_ BO_ 26 "Wheel angular speed (high)";
CM_ SG_ 26 WheelAngularSpeed_2 "Wheel angular speed";
CM_ SG_ 26 WheelAngularSpeed_3 "Wheel angular speed";
CM_ BO_ 27 "Slip angle (low)";
CM_ SG_ 27 SlipAngle_0 "Slip angle";
CM_ SG_ 27 SlipAngle_1 "Slip angle";
CM_ BO_ 28 "Slip angle (high)";
CM_ SG_ 28 SlipAngle_2 "Slip angle";
CM_ SG_ 28 SlipAngle_3 "Slip angle";
CM_ BO_ 29 "Slip angle at contact patch (low)";
CM_ SG_ 29 SlipAngle_ContactPatch_0 "Slip angle at contact patch";
CM_ SG_ 29 SlipAngle_ContactPatch_1 "Slip angle at contact patch";
CM_ BO_ 30 "Slip angle at contact patch (high)";
CM_ SG_ 30 SlipAngle_ContactPatch_2 "Slip angle at contact patch";
CM_ SG_ 30 SlipAngle_ContactPatch_3 "Slip angle at contact patch";
CM_ BO_ 31 "Slip ratio (low)";
CM_ SG_ 31 SlipRatio_0 "Slip ratio";
CM_ SG_ 31 SlipRatio_1 "Slip ratio";
CM_ BO_ 32 "Slip ratio (high)";
CM_ SG_ 32 SlipRatio_2 "Slip ratio";
CM_ SG_ 32 SlipRatio_3 "Slip ratio";
CM_ BO_ 33 "Tyre slip (low)";
CM_ SG_ 33 TyreSlip_0 "Tyre slip";
CM_ SG_ 33 TyreSlip_1 "Tyre slip";
CM_ BO_ 34 "Tyre slip (high)";
CM_ SG_ 34 TyreSlip_2 "Tyre slip";
CM_ SG_ 34 TyreSlip_3 "Tyre slip";
CM_ BO_ 35 "Normalized slip (low)";
CM_ SG_ 35 NdSlip_0 "Normalized slip";
CM_ SG_ 35 NdSlip_1 "Normalized slip";
CM_ BO_ 36 "Normalized slip (high)";
CM_ SG_ 36 NdSlip_2 "Normalized slip";
CM_ SG_ 36 NdSlip_3 "Normalized slip";
CM_ BO_ 37 "Wheel load (low)";
CM_ SG_ 37 Load_0 "Wheel load";
CM_ SG_ 37 Load_1 "Wheel load";
CM_ BO_ 38 "Wheel load (high)";
CM_ SG_ 38 Load_2 "Wheel load";
CM_ SG_ 38 Load_3 "Wheel load";
CM_ BO_ 39 "Lateral force coefficient (low)";
CM_ SG_ 39 Dy_0 "Lateral force coefficient";
CM_ SG_ 39 Dy_1 "Lateral force coefficient";
CM_ BO_ 40 "Lateral force coefficient (high)";
CM_ SG_ 40 Dy_2 "Lateral force coefficient";
CM_ SG_ 40 Dy_3 "Lateral force coefficient";
CM_ BO_ 41 "Aligning moment (low)";
CM_ SG_ 41 Mz_0 "Aligning moment";
CM_ SG_ 41 Mz_1 "Aligning moment";
CM_ BO_ 42 "Aligning moment (high)";
CM_ SG_ 42 Mz_2 "Aligning moment";
CM_ SG_ 42 Mz_3 "Aligning moment";
CM_ BO_ 43 "Tyre dirt level (low)";
CM_ SG_ 43 TyreDirtyLevel_0 "Tyre dirt level";
CM_ SG_ 43 TyreDirtyLevel_1 "Tyre dirt level";
CM_ BO_ 44 "Tyre dirt level (high)";
CM_ SG_ 44 TyreDirtyLevel_2 "Tyre dirt level";
CM_ SG_ 44 TyreDirtyLevel_3 "Tyre dirt level";
CM_ BO_ 45 "Camber angle (low)";
CM_ SG_ 45 CamberRAD_0 "Camber angle";
CM_ SG_ 45 CamberRAD_1 "Camber angle";
CM_ BO_ 46 "Camber angle (high)";
CM_ SG_ 46 CamberRAD_2 "Camber angle";
CM_ SG_ 46 CamberRAD_3 "Camber angle";
CM_ BO_ 47 "Tyre radius (low)";
CM_ SG_ 47 TyreRadius_0 "Tyre radius";
CM_ SG_ 47 TyreRadius_1 "Tyre radius";
CM_ BO_ 48 "Tyre radius (high)";
CM_ SG_ 48 TyreRadius_2 "Tyre radius";
CM_ SG_ 48 TyreRadius_3 "Tyre radius";
CM_ BO_ 49 "Tyre loaded radius (low)";
CM_ SG_ 49 TyreLoadedRadius_0 "Tyre loaded radius";
CM_ SG_ 49 TyreLoadedRadius_1 "Tyre loaded radius";
CM_ BO_ 50 "Tyre loaded radius (high)";
CM_ SG_ 50 TyreLoadedRadius_2 "Tyre loaded radius";
CM_ SG_ 50 TyreLoadedRadius_3 "Tyre loaded radius";
CM_ BO_ 51 "Suspension height (low)";
CM_ SG_ 51 SuspensionHeight_0 "Suspension height";
CM_ SG_ 51 SuspensionHeight_1 "Suspension height";
CM_ BO_ 52 "Suspension height (high)";
CM_ SG_ 52 SuspensionHeight_2 "Suspension height";
CM_ SG_ 52 SuspensionHeight_3 "Suspension height";
CM_ BO_ 53 "Track position normalized";
CM_ SG_ 53 CarPositionNormalized "Track position normalized";
CM_ BO_ 54 "Car slope";
CM_ SG_ 54 CarSlope "Car slope";
CM_ BO_ 55 "Car world position X";
CM_ SG_ 55 CarCoordinates_X "Car world position X";
CM_ BO_ 56 "Car world position Y";
CM_ SG_ 56 CarCoordinates_Y "Car world position Y";
CM_ BO_ 57 "Car world position Z";
CM_ SG_ 57 CarCoordinates_Z "Car world position Z";

SIG_VALTYPE_ 0 Identifier : 0;
SIG_VALTYPE_ 1 Size : 0;
SIG_VALTYPE_ 2 Speed_Kmh : 1;
SIG_VALTYPE_ 3 Speed_Mph : 1;
SIG_VALTYPE_ 4 Speed_Ms : 1;
SIG_VALTYPE_ 5 Abs_Enabled : 0;
SIG_VALTYPE_ 6 Abs_InAction : 0;
SIG_VALTYPE_ 7 Tc_InAction : 0;
SIG_VALTYPE_ 8 Tc_Enabled : 0;
SIG_VALTYPE_ 9 In_Pit : 0;
SIG_VALTYPE_ 10 Engine_Limiter_On : 0;
SIG_VALTYPE_ 11 AccG_Vertical : 1;
SIG_VALTYPE_ 12 AccG_Horizontal : 1;
SIG_VALTYPE_ 13 AccG_Frontal : 1;
SIG_VALTYPE_ 14 LapTime : 0;
SIG_VALTYPE_ 15 LastLap : 0;
SIG_VALTYPE_ 16 BestLap : 0;
SIG_VALTYPE_ 17 LapCount : 0;
SIG_VALTYPE_ 18 Gas : 1;
SIG_VALTYPE_ 19 Brake : 1;
SIG_VALTYPE_ 20 Clutch : 1;
SIG_VALTYPE_ 21 EngineRPM : 1;
SIG_VALTYPE_ 22 Steer : 1;
SIG_VALTYPE_ 23 Gear : 0;
SIG_VALTYPE_ 24 CgHeight : 1;
SIG_VALTYPE_ 25 WheelAngularSpeed_0 : 1;
SIG_VALTYPE_ 25 WheelAngularSpeed_1 : 1;
SIG_VALTYPE_ 26 WheelAngularSpeed_2 : 1;
SIG_VALTYPE_ 26 WheelAngularSpeed_3 : 1;
SIG_VALTYPE_ 27 SlipAngle_0 : 1;
SIG_VALTYPE_ 27 SlipAngle_1 : 1;
SIG_VALTYPE_ 28 SlipAngle_2 : 1;
SIG_VALTYPE_ 28 SlipAngle_3 : 1;
SIG_VALTYPE_ 29 SlipAngle_ContactPatch_0 : 1;
SIG_VALTYPE_ 29 SlipAngle_ContactPatch_1 : 1;
SIG_VALTYPE_ 30 SlipAngle_ContactPatch_2 : 1;
SIG_VALTYPE_ 30 SlipAngle_ContactPatch_3 : 1;
SIG_VALTYPE_ 31 SlipRatio_0 : 1;
SIG_VALTYPE_ 31 SlipRatio_1 : 1;
SIG_VALTYPE_ 32 SlipRatio_2 : 1;
SIG_VALTYPE_ 32 SlipRatio_3 : 1;
SIG_VALTYPE_ 33 TyreSlip_0 : 1;
SIG_VALTYPE_ 33 TyreSlip_1 : 1;
SIG_VALTYPE_ 34 TyreSlip_2 : 1;
SIG_VALTYPE_ 34 TyreSlip_3 : 1;
SIG_VALTYPE_ 35 NdSlip_0 : 1;
SIG_VALTYPE_ 35 NdSlip_1 : 1;
SIG_VALTYPE_ 36 NdSlip_2 : 1;
SIG_VALTYPE_ 36 NdSlip_3 : 1;
SIG_VALTYPE_ 37 Load_0 : 1;
SIG_VALTYPE_ 37 Load_1 : 1;
SIG_VALTYPE_ 38 Load_2 : 1;
SIG_VALTYPE_ 38 Load_3 : 1;
SIG_VALTYPE_ 39 Dy_0 : 1;
SIG_VALTYPE_ 39 Dy_1 : 1;
SIG_VALTYPE_ 40 Dy_2 : 1;
SIG_VALTYPE_ 40 Dy_3 : 1;
SIG_VALTYPE_ 41 Mz_0 : 1;
SIG_VALTYPE_ 41 Mz_1 : 1;
SIG_VALTYPE_ 42 Mz_2 : 1;
SIG_VALTYPE_ 42 Mz_3 : 1;
SIG_VALTYPE_ 43 TyreDirtyLevel_0 : 1;
SIG_VALTYPE_ 43 TyreDirtyLevel_1 : 1;
SIG_VALTYPE_ 44 TyreDirtyLevel_2 : 1;
SIG_VALTYPE_ 44 TyreDirtyLevel_3 : 1;
SIG_VALTYPE_ 45 CamberRAD_0 : 1;
SIG_VALTYPE_ 45 CamberRAD_1 : 1;
SIG_VALTYPE_ 46 CamberRAD_2 : 1;
SIG_VALTYPE_ 46 CamberRAD_3 : 1;
SIG_VALTYPE_ 47 TyreRadius_0 : 1;
SIG_VALTYPE_ 47 TyreRadius_1 : 1;
SIG_VALTYPE_ 48 TyreRadius_2 : 1;
SIG_VALTYPE_ 48 TyreRadius_3 : 1;
SIG_VALTYPE_ 49 TyreLoadedRadius_0 : 1;
SIG_VALTYPE_ 49 TyreLoadedRadius_1 : 1;
SIG_VALTYPE_ 50 TyreLoadedRadius_2 : 1;
SIG_VALTYPE_ 50 TyreLoadedRadius_3 : 1;
SIG_VALTYPE_ 51 SuspensionHeight_0 : 1;
SIG_VALTYPE_ 51 SuspensionHeight_1 : 1;
SIG_VALTYPE_ 52 SuspensionHeight_2 : 1;
SIG_VALTYPE_ 52 SuspensionHeight_3 : 1;
SIG_VALTYPE_ 53 CarPositionNormalized : 1;
SIG_VALTYPE_ 54 CarSlope : 1;
SIG_VALTYPE_ 55 CarCoordinates_X : 1;
SIG_VALTYPE_ 56 CarCoordinates_Y : 1;
SIG_VALTYPE_ 57 CarCoordinates_Z : 1;
